## conf/bblayers.conf
```bitbake
# define the ROS 2 Yocto target release
ROS_OE_RELEASE_SERIES = "zeus"

# define ROS 2 distro
ROS_DISTRO = "foxy"
```

## conf/layer.conf
```bitbake
BBPATH .= ":${LAYERDIR}"

# We have recipes-* directories, add to BBFILES
BBFILES += "${LAYERDIR}/recipes-*/*/*.bb \
            ${LAYERDIR}/recipes-*/*/*/*.bbappend \
            ${LAYERDIR}/recipes-*/*/*.bbappend"

BBFILE_COLLECTIONS += "meta-ampere"
BBFILE_PATTERN_meta-ampere = "^${LAYERDIR}/"
BBFILE_PRIORITY_meta-ampere = "8"

LAYERDEPENDS_meta-ampere = "core"
LAYERSERIES_COMPAT_meta-ampere = "dunfell zeus"
```
